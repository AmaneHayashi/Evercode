DAT SEGMENT
  A DB 20
  B DB 15
  Y DB 3 DUP(0)
  Z DB 0,0
DAT ENDS
STA SEGMENT STACK
  DW 50 DUP(?)
STA ENDS
COD SEGMENT
  ASSUME CS:COD,DS:DAT
  STAR PROC FAR
    PUSH DS
    XOR AX,AX
    PUSH AX
    MOV AX,DAT
    MOV DS,AX
    MOV AX,STA
    MOV SS,AX
    MOV AL,A
    MOV Z,AL
    MOV Z+1,AL
    CALL SUB1
    MOV AL,B
    MOV Z,AL
    MOV Z+1,AL
    CALL SUB1
    MOV AL,A
    MOV Z,AL
    MOV AL,B
    MOV Z+1,AL
    CALL SUB1
    ADD WORD PTR Y,AX
    ADC BYTE PTR[Y+2],0
    RET
    STAR ENDP
  SUB1 PROC
    MOV AL,Z
    MOV AH,Z+1
    MUL AH
    ADD WORD PTR Y,AX
    ADC BYTE PTR[Y+2],0
    RET
    SUB1 ENDP
  COD ENDS
END STAR
